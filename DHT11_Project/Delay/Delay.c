#include <reg52.h> 
#include "Delay.h" 
#include "Type.h" 

/** 
 * 函数名称：	Timer0_Init
 *
 * 功能说明：	定时器0的初始化
 *
 * 参数说明：	无
 *
 * 函数返回：	无
 */
void Timer0_Init()
{
	TMOD &= 0xF0;		// 清除定时器0工作模式配置（保留定时器1工作模式配置）
	TMOD |= 0x01;  	// 配置定时器0工作模式1（16位定时器模式）
	TF0 = 0;      	// 清除溢出中断标志位
	TR0 = 0;      	// 停止定时器
}

/** 
 * 函数名称：	Delay_us（14us - 1ms）
 *
 * 功能说明：	1、 最低延时14us（当us=0时）；
 *						2、 us加1，则延时增加6us；
 *						3、 最高延时1ms
 * 						4、 误差为0
 *
 * 参数说明：	us - 要延时的微秒数
 *
 * 函数返回：	无
 */
void Delay_us(u8 us)
{
	while(us--);
}

/** 
 * 函数名称：	Delay_ms(1ms - 1min)
 *
 * 功能说明：	1、 最低延时1ms（当ms=1时）；
 *						2、 ms加1，则延时增加1ms；
 *						3、 最高延时1分钟
 *						4、 ms越大，误差越大. ms = 1 时误差为0，延时1分钟时误差为3%
 *
 * 参数说明：	ms - 要延时的毫秒数
 *
 * 函数返回：	无
 */
void Delay_ms(u16 ms)
{
	/* 循环一次则完成一次1ms的延时 */
	while(ms--)
	{
		/* 设置定时器初值 */
		/* 40是测量修正值 */		
		TH0 = (65536-1000+40) >> 8;  			// 定时器初值高字节
		TL0 = (65536-1000+40) & 0xFF;			// 定时器初值低字节

		/* 启动定时器 */
		TR0 = 1;

		/* 等待定时器溢出 */
		while (TF0 == 0); 		// 等待定时器溢出标志位被置位

		/* 关闭定时器 */
		TR0 = 0;
		TF0 = 0; 							// 清除溢出标志
	}
}